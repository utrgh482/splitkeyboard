## Kconfig.defconfig
```kconfig
if SHIELD_DNERD_LEFT

config ZMK_KEYBOARD_NAME
    default "DNerd Split"

config ZMK_SPLIT_ROLE_CENTRAL
    default y

endif

if SHIELD_DNERD_LEFT || SHIELD_DNERD_RIGHT

config ZMK_SPLIT
    default y

endif
```

## dnerd_zmk_config/config/boards/shields/dnerd/Kconfig.shield
```kconfig
config SHIELD_DNERD_LEFT
    def_bool $(shields_list_contains,dnerd_left)

config SHIELD_DNERD_RIGHT
    def_bool $(shields_list_contains,dnerd_right)
```
